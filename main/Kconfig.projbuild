## main/Kconfig.projbuild
```kconfig
# SPDX-License-Identifier: Unlicense

menu "esp32-ntp configuration"

comment "Network"

choice APP_NETWORK
    prompt "Network interface"
    default APP_NETWORK_WIZNET
    help
        Use WIZnet W5500 Ethernet or WiFi STA for DHCP, NTP server, and stats.

config APP_NETWORK_WIZNET
    bool "WIZnet W5500 Ethernet"

config APP_NETWORK_WIFI
    bool "WiFi STA"
    depends on IDF_TARGET_ESP32
    help
        Use ESP32 WiFi station with DHCP. NTP and stats work the same as over Ethernet.

endchoice

config APP_WIFI_SSID
    string "WiFi SSID"
    default "myssid"
    depends on APP_NETWORK_WIFI

config APP_WIFI_PASSWORD
    string "WiFi password"
    default "mypassword"
    depends on APP_NETWORK_WIFI

config APP_USE_STATIC_IP
    bool "Use static IP (disable DHCP)"
    default n
    depends on APP_NETWORK_WIZNET || APP_NETWORK_WIFI
    help
        When enabled, use the static IP, gateway, and netmask below. Applies to whichever network interface is selected.

config APP_STATIC_IP_ADDR
    string "Static IP address"
    default "192.168.1.100"
    depends on APP_USE_STATIC_IP

config APP_STATIC_GW
    string "Static gateway"
    default "192.168.1.1"
    depends on APP_USE_STATIC_IP

config APP_STATIC_NETMASK
    string "Static netmask"
    default "255.255.255.0"
    depends on APP_USE_STATIC_IP

comment "NTP / timezone"

config APP_NTP_SERVER
    string "NTP server hostname/IP"
    default "192.168.0.1"
    help
        NTP server to query for time synchronization.

config APP_NTP_PORT
    int "NTP server port"
    range 1 65535
    default 123

config APP_TZ
    string "Timezone (TZ string)"
    default "AST4ADT,M3.2.0,M11.1.0"
    help
        POSIX TZ string, e.g. "EST5EDT,M3.2.0,M11.1.0".

comment "MQTT (Home Assistant)"

config APP_MQTT_ENABLE
    bool "Enable MQTT publishing"
    default n
    depends on APP_NETWORK_WIZNET
    help
        Publishes GPS/NTP status to an MQTT broker with Home Assistant discovery.
        Ethernet only -- runs on the W5500's own hardware TCP/IP stack, same as
        the NTP server and stats endpoint.

config APP_MQTT_BROKER_IP
    string "MQTT broker IPv4 address"
    default ""
    depends on APP_MQTT_ENABLE
    help
        Dotted IPv4 address only. The W5500's onboard TCP/IP stack has no DNS.

config APP_MQTT_BROKER_PORT
    int "MQTT broker port"
    range 1 65535
    default 1883
    depends on APP_MQTT_ENABLE

config APP_MQTT_USERNAME
    string "MQTT username (optional)"
    default ""
    depends on APP_MQTT_ENABLE

config APP_MQTT_PASSWORD
    string "MQTT password (optional)"
    default ""
    depends on APP_MQTT_ENABLE

config APP_MQTT_CLIENT_ID
    string "MQTT client ID"
    default "esp32-ntp"
    depends on APP_MQTT_ENABLE

config APP_MQTT_NODE_ID
    string "MQTT/HA node ID (topic prefix)"
    default "esp32ntp"
    depends on APP_MQTT_ENABLE
    help
        Used as the MQTT topic prefix and the Home Assistant device identifier.
        Must be safe to use as an MQTT topic segment (no '/', '+', '#', spaces).

config APP_MQTT_PUBLISH_INTERVAL_S
    int "Status publish interval (seconds)"
    range 5 3600
    default 30
    depends on APP_MQTT_ENABLE

comment "SPI / Display"

config APP_USE_DISPLAY
    bool "Enable LED display"
    default y

config APP_USE_PRESYNC_GLYPH
    bool "Show presync glyph before GPS lock"
    default n
    depends on APP_USE_DISPLAY

config APP_SPI_HOST
    int "SPI host device (SPI2_HOST=2, SPI3_HOST=3)"
    range 1 3
    default 2
    help
        ESP32 SPI host: 2 = HSPI, 3 = VSPI.

config APP_SPI_MOSI_PIN
    int "SPI MOSI GPIO"
    range 0 39
    default 23

config APP_SPI_SCLK_PIN
    int "SPI SCLK GPIO"
    range 0 39
    default 18

config APP_CS_PIN
    int "MAX7219 CS GPIO"
    range 0 39
    default 5

config APP_MAX_DEVICES
    int "MAX7219 cascade size"
    range 1 8
    default 4

config APP_SPI_CLOCK_HZ
    int "SPI clock (Hz)"
    range 100000 26000000
    default 10000000

endmenu
```
